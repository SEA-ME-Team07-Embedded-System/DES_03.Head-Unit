## Yocto/poky/4/conf/bblayers.conf
```bitbake
# POKY_BBLAYERS_CONF_VERSION is increased each time build/conf/bblayers.conf
# changes incompatibly
POKY_BBLAYERS_CONF_VERSION = "2"

BBPATH = "${TOPDIR}"
BBFILES ?= ""

BBLAYERS ?= " \
  /home/seame-workstation07/daekyung/DES_03.Head-Unit/Yocto/poky/meta \
  /home/seame-workstation07/daekyung/DES_03.Head-Unit/Yocto/poky/meta-poky \
  /home/seame-workstation07/daekyung/DES_03.Head-Unit/Yocto/poky/meta-yocto-bsp \
  "
```

## Yocto/poky/build/conf/bblayers.conf
```bitbake
# POKY_BBLAYERS_CONF_VERSION is increased each time build/conf/bblayers.conf
# changes incompatibly
POKY_BBLAYERS_CONF_VERSION = "2"

BBPATH = "${TOPDIR}"
BBFILES ?= ""

BBLAYERS ?= " \
  /home/seame-workstation07/daekyung/DES_03.Head-Unit/Yocto/poky/meta \
  /home/seame-workstation07/daekyung/DES_03.Head-Unit/Yocto/poky/meta-poky \
  /home/seame-workstation07/daekyung/DES_03.Head-Unit/Yocto/poky/meta-yocto-bsp \
  /home/seame-workstation07/daekyung/DES_03.Head-Unit/Yocto/poky/meta-raspberrypi \
  /home/seame-workstation07/daekyung/DES_03.Head-Unit/Yocto/poky/meta-openembedded/meta-oe \
  /home/seame-workstation07/daekyung/DES_03.Head-Unit/Yocto/poky/meta-openembedded/meta-multimedia \
  /home/seame-workstation07/daekyung/DES_03.Head-Unit/Yocto/poky/meta-openembedded/meta-networking \
  /home/seame-workstation07/daekyung/DES_03.Head-Unit/Yocto/poky/meta-openembedded/meta-perl \
  /home/seame-workstation07/daekyung/DES_03.Head-Unit/Yocto/poky/meta-openembedded/meta-python \
  /home/seame-workstation07/daekyung/DES_03.Head-Unit/Yocto/poky/meta-openembedded/meta-gnome \
  /home/seame-workstation07/daekyung/DES_03.Head-Unit/Yocto/poky/meta-openembedded/meta-initramfs \
  /home/seame-workstation07/daekyung/DES_03.Head-Unit/Yocto/poky/meta-openembedded/meta-filesystems \
  /home/seame-workstation07/daekyung/DES_03.Head-Unit/Yocto/poky/meta-mylayer \
  /home/seame-workstation07/daekyung/DES_03.Head-Unit/Yocto/poky/meta-qt5 \
  /home/seame-workstation07/daekyung/DES_03.Head-Unit/Yocto/poky/meta-python2 \
  "
  
```

## Yocto/poky/meta-anaconda/conf/distro/anaconda.conf
```bitbake
# use systemd as the default init manager
# comment the following lines to use 'sysvinit' as the init manager
VIRTUAL-RUNTIME_init_manager = "systemd"
DISTRO_FEATURES_BACKFILL_CONSIDERED:append = " sysvinit"
DISTRO_FEATURES:append = " systemd"

DISTRO_FEATURES:append = " \
    x11 \
    opengl \
    pam \
"

VIRTUAL-RUNTIME_base-utils = "busybox"

KERNEL_CLASSES:append = " anaconda_kernel"

IMAGE_FEATURES:append = " package-management"

# Want ldconfig in the output package
# The python module require it
DISTRO_FEATURES:append = " ldconfig"

# It works for both of syslinux and grub-efi
LABELS_LIVE = "boot"

# Have graphics and serial in the boot menu when use grub-efi in iso
GRUB_GFXSERIAL = "1"

QB_MEM:qemux86-64 = "-m 2048"

HOSTTOOLS:append = " tac"

MACHINE_FEATURES:append = " efi pcbios"

UVESA_MODE = "1024x768-32"

# The unit is block and size of one block is always 1024 bytes
# Overwrite default value '512' to make UEFI eltorito boot image work
BOOTIMG_EXTRA_SPACE = "4096"
```

## Yocto/poky/meta-anaconda/conf/layer.conf
```bitbake
# We have a conf and classes directory, add to BBPATH
BBPATH =. "${LAYERDIR}:"

# We have a packages directory, add to BBFILES
BBFILES += "${LAYERDIR}/recipes-*/*/*.bb \
            ${LAYERDIR}/recipes-*/*/*.bbappend"

BBFILE_COLLECTIONS += "meta-anaconda"
BBFILE_PATTERN_meta-anaconda = "^${LAYERDIR}/"
BBFILE_PRIORITY_meta-anaconda = "10"

LAYERVERSION_meta-anaconda = "2"

LAYERSERIES_COMPAT_meta-anaconda = "kirkstone"

LAYERDEPENDS_meta-anaconda = " \
    core \
    openembedded-layer \
    filesystems-layer \
    gnome-layer \
    meta-python \
    networking-layer \
    meta-initramfs \
"

LAYER_PATH_meta-anaconda = "${LAYERDIR}"

KERNEL_CLASSES:append = " ${@bb.utils.contains('DISTRO_FEATURES', 'anaconda-support', 'anaconda_support_kernel', '', d)}"
IMAGE_CLASSES:append = " ${@bb.utils.contains('DISTRO_FEATURES', 'anaconda-support', 'anaconda_support_image', '', d)}"
```
